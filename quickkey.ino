#include <Wire.h>
#include <Adafruit_GFX.h>
#include <Adafruit_SSD1306.h>
#include <WiFi.h>
#include <WiFiUdp.h>
#include <Preferences.h>

// === Wi-Fi config ===
const char* ssid = "Home_wifi";
const char* password = "ThePassword?";
const int udpPort = 5555;
WiFiUDP udp;
IPAddress broadcastIP;
bool wifiActive = false;

// === Screen config ===
#define SCREEN_WIDTH 128
#define SCREEN_HEIGHT 64
#define OLED_ADDR 0x3C
Adafruit_SSD1306 display(SCREEN_WIDTH, SCREEN_HEIGHT, &Wire, -1);

// === Pins ===
#define PIN_BUTTON 6
#define PIN_FLAG   7
#define PIN_SDA    4
#define PIN_SCL    5
#define PIN_RX     20
#define PIN_TX     21

// === Debounce ===
unsigned long lastDebounceTime = 0;
unsigned long debounceDelay = 25;
bool buttonState = HIGH;
bool lastButtonReading = HIGH;

// === Bus Communication ===
#define BAUD 115200
bool isMaster = false;
String guid;
String unitName;
Preferences prefs;
unsigned long lastSlaveAnnounce = 0;
unsigned long slaveAnnounceInterval = 5000;

// === Animation state machine ===
enum AnimState { IDLE, TRIGGERED, COMBO };
AnimState animState = IDLE;
unsigned long lastFrameTime = 0;
unsigned long stateStartTime = 0;
int currentFrame = 0;
bool animationReverse = false;
String overlayText = "";
const int IDLE_FRAME_DELAY      = 120;
const int TRIGGERED_FRAME_DELAY = 55;
const int COMBO_FRAME_DELAY     = 35;
const unsigned long TRIGGERED_DURATION = 1500;
const unsigned long COMBO_DURATION     = 2500;

// === Long press ===
unsigned long buttonPressedAt = 0;
bool longPressFired = false;
const unsigned long LONG_PRESS_MS = 800;

// === Slave tracking (master only) ===
#define MAX_SLAVES 8
struct SlaveInfo { String guid; String name; unsigned long lastSeen; };
SlaveInfo slaves[MAX_SLAVES];
int slaveCount = 0;
const unsigned long SLAVE_TIMEOUT = 15000;

// === Combo detection (master only) ===
#define MAX_COMBO_TRACK 8
struct RecentTrigger { String name; unsigned long time; };
RecentTrigger recentTriggers[MAX_COMBO_TRACK];
int recentTriggerCount = 0;
const unsigned long COMBO_WINDOW_MS = 600;

// === Sprite frames (45x45px) ===
// ========================================
// ANIMATION FRAMES - Dance (46x46px, 20 frames)
// ========================================
// 'frame_00_delay-0', 46x46px
const unsigned char frame_00 [] PROGMEM = {
	0x00, 0x00, 0x00, 0x00, 0x00, 0x00, 0x00, 0x00, 0x00, 0x00, 0x00, 0x00, 0x00, 0x00, 0x00, 0x00, 
	0x00, 0x00, 0x00, 0x00, 0x00, 0x00, 0x00, 0x00, 0x00, 0x00, 0x00, 0x00, 0x00, 0x00, 0x00, 0x00, 
	0x07, 0xfc, 0x00, 0x00, 0x00, 0x00, 0x3f, 0xff, 0x80, 0x00, 0x00, 0x01, 0xff, 0xff, 0xe0, 0x00, 
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	0x00, 0x00, 0x00, 0x00
};
// 'frame_01_delay-0', 46x46px
const unsigned char frame_01 [] PROGMEM = {
	0x00, 0x00, 0x00, 0x00, 0x00, 0x00, 0x00, 0x00, 0x00, 0x00, 0x00, 0x00, 0x00, 0x00, 0x00, 0x00, 
	0x00, 0x00, 0x00, 0x00, 0x00, 0x00, 0x00, 0x00, 0x00, 0x00, 0x00, 0x00, 0x00, 0x00, 0x00, 0x00, 
	0x3f, 0xf0, 0x00, 0x00, 0x00, 0x01, 0xff, 0xfe, 0x00, 0x00, 0x00, 0x0f, 0xff, 0xff, 0xc0, 0x00, 
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	0x00, 0x00, 0x00, 0x00
};
// 'frame_02_delay-0', 46x46px
const unsigned char frame_02 [] PROGMEM = {
	0x00, 0x00, 0x00, 0x00, 0x00, 0x00, 0x00, 0x00, 0x00, 0x00, 0x00, 0x00, 0x00, 0x00, 0x00, 0x00, 
	0x00, 0x00, 0x00, 0x00, 0x00, 0x00, 0x00, 0x00, 0x00, 0x00, 0x00, 0x00, 0x00, 0x00, 0x00, 0x00, 
	0x7f, 0xc0, 0x00, 0x00, 0x00, 0x03, 0xff, 0xf8, 0x00, 0x00, 0x00, 0x0f, 0xff, 0xff, 0x00, 0x00, 
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	0x00, 0x00, 0x00, 0x00
};
// 'frame_03_delay-0', 46x46px
const unsigned char frame_03 [] PROGMEM = {
	0x00, 0x00, 0x00, 0x00, 0x00, 0x00, 0x00, 0x00, 0x00, 0x00, 0x00, 0x00, 0x00, 0x00, 0x00, 0x00, 
	0x00, 0x00, 0x00, 0x00, 0x00, 0x00, 0x00, 0x00, 0x00, 0x00, 0x00, 0x00, 0x00, 0x00, 0x00, 0x00, 
	0x00, 0x00, 0x00, 0x00, 0x00, 0x00, 0x7f, 0x80, 0x00, 0x00, 0x00, 0x0f, 0xff, 0xf8, 0x00, 0x00, 
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	0x00, 0x00, 0x00, 0x00
};
// 'frame_04_delay-0', 46x46px
const unsigned char frame_04 [] PROGMEM = {
	0x00, 0x00, 0x00, 0x00, 0x00, 0x00, 0x00, 0x00, 0x00, 0x00, 0x00, 0x00, 0x00, 0x00, 0x00, 0x00, 
	0x00, 0x00, 0x00, 0x00, 0x00, 0x00, 0x00, 0x00, 0x00, 0x00, 0x00, 0x00, 0x00, 0x00, 0x00, 0x00, 
	0x00, 0x00, 0x00, 0x00, 0x00, 0x07, 0xff, 0x00, 0x00, 0x00, 0x00, 0x3f, 0xff, 0xf0, 0x00, 0x00, 
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	0x00, 0x00, 0x00, 0x00
};
// 'frame_05_delay-0', 46x46px
const unsigned char frame_05 [] PROGMEM = {
	0x00, 0x00, 0x00, 0x00, 0x00, 0x00, 0x00, 0x00, 0x00, 0x00, 0x00, 0x00, 0x00, 0x00, 0x00, 0x00, 
	0x00, 0x00, 0x00, 0x00, 0x00, 0x00, 0x00, 0x00, 0x00, 0x00, 0x00, 0x00, 0x00, 0x00, 0x00, 0x00, 
	0x00, 0x00, 0x00, 0x00, 0x00, 0x0f, 0xff, 0xc0, 0x00, 0x00, 0x00, 0x7f, 0xff, 0xf8, 0x00, 0x00, 
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	0x00, 0x00, 0x00, 0x00
};
// 'frame_06_delay-0', 46x46px
const unsigned char frame_06 [] PROGMEM = {
	0x00, 0x00, 0x00, 0x00, 0x00, 0x00, 0x00, 0x00, 0x00, 0x00, 0x00, 0x00, 0x00, 0x00, 0x00, 0x00, 
	0x00, 0x00, 0x00, 0x00, 0x00, 0x00, 0x00, 0x00, 0x00, 0x00, 0x00, 0x00, 0x00, 0x00, 0x00, 0x00, 
	0x00, 0x00, 0x00, 0x00, 0x00, 0x00, 0x00, 0x00, 0x00, 0x00, 0x00, 0x00, 0xe0, 0x00, 0x00, 0x00, 
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	0x00, 0x00, 0x00, 0x00
};
// 'frame_07_delay-0', 46x46px
const unsigned char frame_07 [] PROGMEM = {
	0x00, 0x00, 0x00, 0x00, 0x00, 0x00, 0x00, 0x00, 0x00, 0x00, 0x00, 0x00, 0x00, 0x00, 0x00, 0x00, 
	0x00, 0x00, 0x00, 0x00, 0x00, 0x00, 0x00, 0x00, 0x00, 0x00, 0x00, 0x00, 0x00, 0x00, 0x00, 0x00, 
	0x00, 0x00, 0x00, 0x00, 0x00, 0x00, 0x00, 0x00, 0x00, 0x00, 0x00, 0x00, 0x00, 0x00, 0x00, 0x00, 
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	0x00, 0x00, 0x00, 0x00
};
// 'frame_08_delay-0', 46x46px
const unsigned char frame_08 [] PROGMEM = {
	0x00, 0x00, 0x00, 0x00, 0x00, 0x00, 0x00, 0x00, 0x00, 0x00, 0x00, 0x00, 0x00, 0x00, 0x00, 0x00, 
	0x00, 0x00, 0x00, 0x00, 0x00, 0x00, 0x00, 0x00, 0x00, 0x00, 0x00, 0x00, 0x00, 0x00, 0x00, 0x00, 
	0x00, 0x00, 0x00, 0x00, 0x00, 0x00, 0x00, 0x00, 0x00, 0x00, 0x00, 0x00, 0x00, 0x00, 0x00, 0x00, 
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	0x00, 0x00, 0x00, 0x00
};
// 'frame_09_delay-0', 46x46px
const unsigned char frame_09 [] PROGMEM = {
	0x00, 0x00, 0x00, 0x00, 0x00, 0x00, 0x00, 0x00, 0x00, 0x00, 0x00, 0x00, 0x00, 0x00, 0x00, 0x00, 
	0x00, 0x00, 0x00, 0x00, 0x00, 0x00, 0x00, 0x00, 0x00, 0x00, 0x00, 0x00, 0x00, 0x00, 0x00, 0x00, 
	0x00, 0x00, 0x00, 0x00, 0x00, 0x00, 0x00, 0x00, 0x00, 0x00, 0x00, 0x00, 0x00, 0x00, 0x00, 0x00, 
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	0x00, 0x00, 0x00, 0x00
};
// 'frame_10_delay-0', 46x46px
const unsigned char frame_10 [] PROGMEM = {
	0x00, 0x00, 0x00, 0x00, 0x00, 0x00, 0x00, 0x00, 0x00, 0x00, 0x00, 0x00, 0x00, 0x00, 0x00, 0x00, 
	0x00, 0x00, 0x00, 0x00, 0x00, 0x00, 0x00, 0x00, 0x00, 0x00, 0x00, 0x00, 0x00, 0x00, 0x00, 0x00, 
	0x00, 0x00, 0x00, 0x00, 0x00, 0x00, 0x00, 0x00, 0x00, 0x00, 0x00, 0x00, 0x00, 0x00, 0x00, 0x00, 
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	0x00, 0x00, 0x00, 0x00
};
// 'frame_11_delay-0', 46x46px
const unsigned char frame_11 [] PROGMEM = {
	0x00, 0x00, 0x00, 0x00, 0x00, 0x00, 0x00, 0x00, 0x00, 0x00, 0x00, 0x00, 0x00, 0x00, 0x00, 0x00, 
	0x00, 0x00, 0x00, 0x00, 0x00, 0x00, 0x00, 0x00, 0x00, 0x00, 0x00, 0x00, 0x00, 0x00, 0x00, 0x00, 
	0x00, 0x00, 0x00, 0x00, 0x00, 0x00, 0x00, 0x00, 0x00, 0x00, 0x00, 0x00, 0x00, 0x00, 0x00, 0x00, 
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	0x00, 0x00, 0x00, 0x00
};
// 'frame_12_delay-0', 46x46px
const unsigned char frame_12 [] PROGMEM = {
	0x00, 0x00, 0x00, 0x00, 0x00, 0x00, 0x00, 0x00, 0x00, 0x00, 0x00, 0x00, 0x00, 0x00, 0x00, 0x00, 
	0x00, 0x00, 0x00, 0x00, 0x00, 0x00, 0x00, 0x00, 0x00, 0x00, 0x00, 0x00, 0x00, 0x00, 0x00, 0x00, 
	0x00, 0x00, 0x00, 0x00, 0x00, 0x00, 0x00, 0x00, 0x00, 0x00, 0x00, 0x00, 0x00, 0x00, 0x00, 0x00, 
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	0x00, 0x00, 0x00, 0x00
};
// 'frame_13_delay-0', 46x46px
const unsigned char frame_13 [] PROGMEM = {
	0x00, 0x00, 0x00, 0x00, 0x00, 0x00, 0x00, 0x00, 0x00, 0x00, 0x00, 0x00, 0x00, 0x00, 0x00, 0x00, 
	0x00, 0x00, 0x00, 0x00, 0x00, 0x00, 0x00, 0x00, 0x00, 0x00, 0x00, 0x00, 0x00, 0x00, 0x00, 0x00, 
	0x00, 0x00, 0x00, 0x00, 0x00, 0x00, 0x00, 0x00, 0x00, 0x00, 0x00, 0x00, 0x00, 0x00, 0x00, 0x00, 
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	0x00, 0x00, 0x00, 0x00
};
// 'frame_14_delay-0', 46x46px
const unsigned char frame_14 [] PROGMEM = {
	0x00, 0x00, 0x00, 0x00, 0x00, 0x00, 0x00, 0x00, 0x00, 0x00, 0x00, 0x00, 0x00, 0x00, 0x00, 0x00, 
	0x00, 0x00, 0x00, 0x00, 0x00, 0x00, 0x00, 0x00, 0x00, 0x00, 0x00, 0x00, 0x00, 0x00, 0x00, 0x00, 
	0x00, 0x00, 0x00, 0x00, 0x00, 0x00, 0x00, 0x00, 0x00, 0x00, 0x00, 0x00, 0x00, 0x00, 0x00, 0x00, 
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	0x00, 0x00, 0x00, 0x00
};
// 'frame_15_delay-0', 46x46px
const unsigned char frame_15 [] PROGMEM = {
	0x00, 0x00, 0x00, 0x00, 0x00, 0x00, 0x00, 0x00, 0x00, 0x00, 0x00, 0x00, 0x00, 0x00, 0x00, 0x00, 
	0x00, 0x00, 0x00, 0x00, 0x00, 0x00, 0x00, 0x00, 0x00, 0x00, 0x00, 0x00, 0x00, 0x00, 0x00, 0x00, 
	0x00, 0x00, 0x00, 0x00, 0x00, 0x00, 0x00, 0x00, 0x00, 0x00, 0x00, 0x00, 0x00, 0x00, 0x00, 0x00, 
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	0x00, 0x00, 0x00, 0x00
};
// 'frame_19_delay-0', 46x46px
const unsigned char frame_19 [] PROGMEM = {
	0x00, 0x00, 0x00, 0x00, 0x00, 0x00, 0x00, 0x00, 0x00, 0x00, 0x00, 0x00, 0x00, 0x00, 0x00, 0x00, 
	0x00, 0x00, 0x00, 0x00, 0x00, 0x00, 0x00, 0x00, 0x00, 0x00, 0x00, 0x00, 0x00, 0x00, 0x00, 0x00, 
	0x01, 0xfc, 0x00, 0x00, 0x00, 0x00, 0x1f, 0xff, 0xe0, 0x00, 0x00, 0x00, 0xff, 0xff, 0xf8, 0x00, 
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	0x00, 0x00, 0x00, 0x00
};
// 'frame_16_delay-0', 46x46px
const unsigned char frame_16 [] PROGMEM = {
	0x00, 0x00, 0x00, 0x00, 0x00, 0x00, 0x00, 0x00, 0x00, 0x00, 0x00, 0x00, 0x00, 0x00, 0x00, 0x00, 
	0x00, 0x00, 0x00, 0x00, 0x00, 0x00, 0x00, 0x00, 0x00, 0x00, 0x00, 0x00, 0x00, 0x00, 0x00, 0x00, 
	0x00, 0x00, 0x00, 0x00, 0x00, 0x00, 0x00, 0x00, 0x00, 0x00, 0x00, 0x00, 0x00, 0x00, 0x00, 0x00, 
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	0x00, 0x00, 0x00, 0x00
};
// 'frame_17_delay-0', 46x46px
const unsigned char frame_17 [] PROGMEM = {
	0x00, 0x00, 0x00, 0x00, 0x00, 0x00, 0x00, 0x00, 0x00, 0x00, 0x00, 0x00, 0x00, 0x00, 0x00, 0x00, 
	0x00, 0x00, 0x00, 0x00, 0x00, 0x00, 0x00, 0x00, 0x00, 0x00, 0x00, 0x00, 0x00, 0x00, 0x00, 0x00, 
	0x00, 0x00, 0x00, 0x00, 0x00, 0x00, 0x00, 0xff, 0xe0, 0x00, 0x00, 0x00, 0x07, 0xff, 0xfc, 0x00, 
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	0x00, 0x00, 0x00, 0x00
};
// 'frame_18_delay-0', 46x46px
const unsigned char frame_18 [] PROGMEM = {
	0x00, 0x00, 0x00, 0x00, 0x00, 0x00, 0x00, 0x00, 0x00, 0x00, 0x00, 0x00, 0x00, 0x00, 0x00, 0x00, 
	0x00, 0x00, 0x00, 0x00, 0x00, 0x00, 0x00, 0x00, 0x00, 0x00, 0x00, 0x00, 0x00, 0x00, 0x00, 0x00, 
	0x00, 0x00, 0x00, 0x00, 0x00, 0x00, 0x03, 0xff, 0xf0, 0x00, 0x00, 0x00, 0x1f, 0xff, 0xfc, 0x00, 
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	0x00, 0x00, 0x00, 0x00
};

const unsigned char* frames[] = { frame_00, frame_01, frame_02,frame_03,frame_04,frame_05,frame_06,frame_07,frame_08,frame_09,frame_10,frame_11,frame_12,frame_13,frame_14,frame_15,frame_16,frame_17,frame_18,frame_19 };
const int frameCount = sizeof(frames) / sizeof(frames[0]);

// === Forward declarations ===
void renderDisplay(int frameIndex);
void handleMessage(const String &msg);
void busSend(const String &msg);
void broadcastMessage(const String &msg);
void setupGUID();
void setupUnitName();
void determineRole();
void updateSlaveList(const String &slaveGuid, const String &slaveName);
void checkCombo(const String &name);
void enterState(AnimState s, const String &overlay);

// === Setup GUID ===
void setupGUID() {
  uint64_t chipid = ESP.getEfuseMac();
  guid = String((uint32_t)(chipid >> 32), HEX) + String((uint32_t)chipid, HEX);
}

void setupUnitName() {
  prefs.begin("quickkey", false);
  unitName = prefs.getString("name", "");
  if (unitName.length() == 0) {
    unitName = guid.substring(guid.length() - 4);
    prefs.putString("name", unitName);
  }
  prefs.end();
}

// === Determine master/slave role ===
void determineRole() {
  if (digitalRead(PIN_FLAG) == HIGH) {
    isMaster = false;
    pinMode(PIN_FLAG, INPUT);
  } else {
    isMaster = true;
    pinMode(PIN_FLAG, OUTPUT);
    digitalWrite(PIN_FLAG, HIGH);
  }
}

// === Send message over bus ===
void busSend(const String &msg) {
  Serial1.println(msg);
}

// === Broadcast message over Wi-Fi and bus ===
void broadcastMessage(const String &msg) {
  // Add source GUID to message if not already present
  String fullMsg = msg;
  if (!msg.endsWith(guid)) {
    fullMsg = msg + "_" + guid;
  }
  
  if (wifiActive) {
    udp.beginPacket(broadcastIP, udpPort);
    udp.print(fullMsg);
    udp.endPacket();
  }
  busSend(fullMsg);
}

// === State transition helper ===
void enterState(AnimState s, const String &overlay) {
  animState = s;
  stateStartTime = millis();
  currentFrame = 0;
  animationReverse = false;
  overlayText = overlay;
}

// === Slave list update ===
void updateSlaveList(const String &slaveGuid, const String &slaveName) {
  unsigned long now = millis();
  for (int i = 0; i < slaveCount; i++) {
    if (slaves[i].guid == slaveGuid) {
      slaves[i].lastSeen = now;
      slaves[i].name = slaveName;
      return;
    }
  }
  if (slaveCount < MAX_SLAVES) {
    slaves[slaveCount] = { slaveGuid, slaveName, now };
    slaveCount++;
    Serial.println("Slave joined: " + slaveName);
  }
}

// === Combo detection ===
void checkCombo(const String &name) {
  unsigned long now = millis();
  int kept = 0;
  for (int i = 0; i < recentTriggerCount; i++) {
    if (now - recentTriggers[i].time < COMBO_WINDOW_MS)
      recentTriggers[kept++] = recentTriggers[i];
  }
  recentTriggerCount = kept;

  bool found = false;
  for (int i = 0; i < recentTriggerCount; i++) {
    if (recentTriggers[i].name == name) { found = true; break; }
  }
  if (!found && recentTriggerCount < MAX_COMBO_TRACK) {
    recentTriggers[recentTriggerCount] = { name, now };
    recentTriggerCount++;
  }

  if (recentTriggerCount >= 2) {
    recentTriggerCount = 0;
    broadcastMessage("COMBO");
    enterState(COMBO, "COMBO!");
  }
}

// === Handle received command ===
void handleMessage(const String &msg) {
  if (msg.startsWith("TRIGGER")) {
    int first  = msg.indexOf('_');
    int second = msg.indexOf('_', first + 1);
    String senderName = (first >= 0 && second > first) ? msg.substring(first + 1, second) : "?";
    String senderGuid = (second >= 0) ? msg.substring(second + 1) : "";

    enterState(TRIGGERED, senderName);

    if (isMaster && senderGuid != guid) {
      broadcastMessage(msg);
      checkCombo(senderName);
    } else if (isMaster) {
      checkCombo(senderName);
    }

  } else if (msg.startsWith("COMBO")) {
    enterState(COMBO, "COMBO!");

  } else if (msg.startsWith("SLAVE_CONNECTED")) {
    int first  = msg.indexOf('_', 16);
    int second = (first >= 0) ? msg.indexOf('_', first + 1) : -1;
    String slaveName = (first >= 0 && second > first) ? msg.substring(first + 1, second) : "?";
    String slaveGuid = (second >= 0) ? msg.substring(second + 1) : msg.substring(first + 1);
    if (isMaster) updateSlaveList(slaveGuid, slaveName);
  }
}

// === Setup ===
void setup() {
  Serial.begin(115200);
  delay(200);

  pinMode(PIN_BUTTON, INPUT_PULLUP);
  pinMode(PIN_FLAG, INPUT_PULLDOWN);

  Wire.begin(PIN_SDA, PIN_SCL);

  if (!display.begin(SSD1306_SWITCHCAPVCC, OLED_ADDR)) {
    Serial.println("❌ OLED init failed!");
    for (;;);
  }
  display.clearDisplay();
  display.display();

  setupGUID();
  setupUnitName();
  delay(200);
  determineRole();

  // Dynamically swap RX/TX for slaves
  int serialRxPin = PIN_RX;
  int serialTxPin = PIN_TX;
  if (!isMaster) {
    serialRxPin = PIN_TX;
    serialTxPin = PIN_RX;
  }

  Serial1.begin(BAUD, SERIAL_8N1, serialRxPin, serialTxPin);

  Serial.println(isMaster ? "🔸 MASTER started" : "🔹 SLAVE started");
  Serial.println("GUID: " + guid);
  Serial.println("Name: " + unitName);

  delay(500);

  // Slaves announce themselves immediately after setup
  if (!isMaster) {
    String packet = "SLAVE_CONNECTED_" + unitName + "_" + guid;
    busSend(packet);
    Serial.println("📡 Announcing to master");
  }

  delay(500);

  // Master connects to Wi-Fi
  if (isMaster) {
    WiFi.mode(WIFI_STA);
    WiFi.begin(ssid, password);
    Serial.print("Connecting to Wi-Fi");
    unsigned long startAttempt = millis();
    while (WiFi.status() != WL_CONNECTED && millis() - startAttempt < 10000) {
      delay(300);
      Serial.print(".");
    }

    if (WiFi.status() == WL_CONNECTED) {
      wifiActive = true;
      IPAddress local = WiFi.localIP();
      IPAddress subnet = WiFi.subnetMask();
      for (int i = 0; i < 4; i++) broadcastIP[i] = local[i] | (~subnet[i]);
      Serial.println("\n✅ Wi-Fi connected!");
      Serial.print("Local IP: "); Serial.println(local);
      Serial.print("Broadcast IP: "); Serial.println(broadcastIP);
      udp.begin(udpPort);
    } else {
      wifiActive = false;
      WiFi.disconnect(true);
      WiFi.mode(WIFI_OFF);
      Serial.println("\n⚠️ Wi-Fi failed, using bus only");
    }
  }

  // Display role on screen
  display.setTextSize(1);
  display.setTextColor(SSD1306_WHITE);
  const char* roleLabel = isMaster ? "MASTER" : "SLAVE";
  display.setCursor((SCREEN_WIDTH - strlen(roleLabel) * 6) / 2, 18);
  display.print(roleLabel);
  display.setTextSize(2);
  display.setCursor((SCREEN_WIDTH - unitName.length() * 12) / 2, 30);
  display.print(unitName);
  display.setTextSize(1);
  display.display();
  delay(1500);
  display.clearDisplay();
  renderDisplay(0);
}

// === Main loop ===
void loop() {
  unsigned long now = millis();

  // === Handle button input ===
  bool reading = digitalRead(PIN_BUTTON);
  if (reading != lastButtonReading) lastDebounceTime = now;

  if ((now - lastDebounceTime) > debounceDelay) {
    if (reading != buttonState) {
      buttonState = reading;
      if (buttonState == LOW) {
        buttonPressedAt = now;
        longPressFired = false;
      } else {
        if (!longPressFired) {
          String packet = "TRIGGER_" + unitName + "_" + guid;
          if (isMaster) broadcastMessage(packet);
          else busSend(packet);
          handleMessage(packet);
          Serial.println(packet);
        }
      }
    }
    if (buttonState == LOW && !longPressFired && now - buttonPressedAt >= LONG_PRESS_MS) {
      longPressFired = true;
      handleMessage("TRIGGER_" + unitName + "_" + guid);
      Serial.println("Long press: self-only");
    }
  }
  lastButtonReading = reading;

  // === Receive from Wi-Fi ===
  if (wifiActive) {
    int packetSize = udp.parsePacket();
    if (packetSize) {
      char incoming[256];
      int len = udp.read(incoming, 255);
      if (len > 0) incoming[len] = 0;
      handleMessage(String(incoming));
    }
  }

  // === USB serial commands ===
  if (Serial.available()) {
    String cmd = Serial.readStringUntil('\n');
    cmd.trim();
    if (cmd.startsWith("name=")) {
      String newName = cmd.substring(5);
      newName.trim();
      if (newName.length() > 0 && newName.length() <= 12) {
        unitName = newName;
        prefs.begin("quickkey", false);
        prefs.putString("name", unitName);
        prefs.end();
        Serial.println("Name set: " + unitName);
      }
    }
  }

  // === Receive from Serial bus ===
  while (Serial1.available()) {
    String msg = Serial1.readStringUntil('\n');
    msg.trim();
    if (msg.length() > 0) {
      handleMessage(msg);
    }
  }

  // === Periodic slave announce ===
  if (!isMaster && now - lastSlaveAnnounce > slaveAnnounceInterval) {
    lastSlaveAnnounce = now;
    busSend("SLAVE_CONNECTED_" + unitName + "_" + guid);
  }

  // === Prune stale slaves ===
  if (isMaster) {
    for (int i = 0; i < slaveCount; i++) {
      if (now - slaves[i].lastSeen > SLAVE_TIMEOUT) {
        Serial.println("Slave lost: " + slaves[i].name);
        slaves[i] = slaves[--slaveCount];
        i--;
      }
    }
  }

  // === Master loss detection ===
  if (!isMaster && digitalRead(PIN_FLAG) == LOW) {
    unsigned long lostTime = millis();
    while (digitalRead(PIN_FLAG) == LOW && millis() - lostTime < 2000);
    if (digitalRead(PIN_FLAG) == LOW) {
      uint32_t backoff = strtoul(guid.substring(0, 8).c_str(), nullptr, 16) % 500;
      delay(backoff);
      if (digitalRead(PIN_FLAG) == LOW) {
        Serial.println("⚡ Master lost, promoting self");
        pinMode(PIN_FLAG, OUTPUT);
        digitalWrite(PIN_FLAG, HIGH);
        isMaster = true;
      }
    }
  }

  // === Animation state machine ===
  int frameInterval = (animState == COMBO) ? COMBO_FRAME_DELAY :
                      (animState == TRIGGERED) ? TRIGGERED_FRAME_DELAY : IDLE_FRAME_DELAY;

  if (now - lastFrameTime >= (unsigned long)frameInterval) {
    lastFrameTime = now;
    renderDisplay(currentFrame);

    if (animState == IDLE) {
      if (!animationReverse) {
        currentFrame++;
        if (currentFrame >= frameCount - 1) { currentFrame = frameCount - 1; animationReverse = true; }
      } else {
        currentFrame--;
        if (currentFrame <= 0) { currentFrame = 0; animationReverse = false; }
      }
    } else {
      currentFrame = (currentFrame + 1) % frameCount;
      unsigned long elapsed = now - stateStartTime;
      unsigned long duration = (animState == COMBO) ? COMBO_DURATION : TRIGGERED_DURATION;
      if (elapsed >= duration) enterState(IDLE, "");
    }
  }
}

// === Render frame with overlay ===
void renderDisplay(int frameIndex) {
  bool hasOverlay = overlayText.length() > 0;
  int yOffset = hasOverlay ? 16 : 9;

  display.clearDisplay();
  display.drawBitmap(
    (SCREEN_WIDTH - 46) / 2,
    (SCREEN_HEIGHT - 46) / 2 + yOffset,
    frames[frameIndex],
    46, 46, SSD1306_WHITE
  );

  if (hasOverlay) {
    display.setTextSize(1);
    display.setTextColor(SSD1306_WHITE);
    display.setCursor((SCREEN_WIDTH - overlayText.length() * 6) / 2, 1);
    display.print(overlayText);
  }

  if (isMaster && slaveCount > 0) {
    display.setTextSize(1);
    display.setTextColor(SSD1306_WHITE);
    display.setCursor(0, 0);
    display.print(slaveCount);
  }

  display.display();
}